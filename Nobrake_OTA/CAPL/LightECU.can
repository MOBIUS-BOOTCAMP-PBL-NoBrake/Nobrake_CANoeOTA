/*@!Encoding:65001*/
includes
{
  
}

variables
{
  const LighteECU_ID = 0x01;
    // --- 수신 데이터 버퍼 ---
  byte gVumBuffer[5242880]; // 최대 5MB 버퍼 (메모리에만 상주)
  long gExpectedSize = 0;   // Sig_OTA_TotalSize
  word gOtaVersion = 0; //Sig_OTA_Version
  byte gTargetECU_ID; // Sig_TargetECU_ID
  long gCurrentReceived = 0;  
    // --- 상태 관리 ---
  int gIsUpdating = 0;
  int gCurrentIgnition = 0; //시동상태 (0:off, 1:acc, 2:on)
  int gCurrentSpeed = 0;// 차량속도
}

/*--------------------------------------------------
  UpdateProgress(0~100) -> ProgressStateIndex(0~10)
--------------------------------------------------*/
void updateProgressStateIndex()
{
  int progress;
  int state;

  progress = SysGetVariableInt(sysvar::OTA::UpdateProgress);

  if (progress < 0)
    progress = 0;
  else if (progress > 100)
    progress = 100;

  state = progress / 10;

  SysSetVariableInt(sysvar::OTA::ProgressStateIndex, state);

  //write("[LIGHT NODE] UpdateProgress=%d, ProgressStateIndex=%d", progress, state);
}

/*----------------
  initial setting
-----------------*/
on start
{
  SysSetVariableInt(sysvar::OTA::UpdateProgress, 0);
  SysSetVariableInt(sysvar::OTA::ProgressStateIndex, 0);

  //write("[LIGHT NODE] started");
  //write("[LIGHT NODE] UpdateProgress=0, ProgressStateIndex=0");
}

on sysvar sysvar::OTA::UpdateProgress
{
  updateProgressStateIndex();
}



// [1] OTA 메타데이터 수신 (ID: 0x200)
on message VUM_OTA_Metadata
{
  gTargetECU_ID = this.Sig_TargetECU_ID;
  gExpectedSize = this.Sig_OTA_TotalSize;
  gOtaVersion = this.Sig_OTA_Version;
  gCurrentReceived = 0; // 버퍼 인덱스 초기화
  gIsUpdating = 1;
  
  //체크용 로그
  write("[LightECU] OTA 수신 준비 완료: 예상 크기 %ld bytes", gExpectedSize);
  write("[LightECU] 수신된 펌웨어 버전: %u", this.Sig_OTA_Version);
}


// [2] OTA 데이터 블록 수신 (ID: 0x201)
on message VUM_OTA_DataBlock
{
  int i;
  int blockLen;
  long baseIdx;

  if (gIsUpdating == 1 && this.can == 2 && this.dir == Rx)
  {
    blockLen = this.Sig_BlockLen; // 유효 데이터 길이 (최대 6바이트)
    baseIdx = gCurrentReceived;

    if (baseIdx + blockLen <= elcount(gVumBuffer))
    {
      for (i = 0; i < blockLen; i++)
      {
        gVumBuffer[baseIdx + i] = this.Sig_BlockData0_5.byte(i);
      }
      gCurrentReceived += blockLen;
    }

    // --- 수신 확인용 로그 추가 ---
    // 500개 블록마다 한 번씩 현재 수신 상태를 Write 창에 출력합니다.
    if (this.Sig_BlockSeq % 10 == 0) 
      {
        // 데이터의 첫 바이트(byte(0))도 로그에 찍어서 0이 아닌지 확인
        write("[LightECU] 수신 중... 블록번호: %d | 총량: %ld | 샘플데이터: 0x%02X", (int)this.Sig_BlockSeq, gCurrentReceived, (int)this.Sig_BlockData0_5.byte(0));
        write("[LightECU] 진행률: %d%% (%ld/%ld bytes)", 
      (int)(gCurrentReceived * 100 / gExpectedSize), 
      gCurrentReceived, 
      gExpectedSize);
      }
  }
}

// [3] OTA 전송 종료 수신 (ID: 0x202)
on message VUM_OTA_TransferEnd
{
  if (gIsUpdating == 1 && this.can == 2 && this.dir == Rx)
  {
    // 파일 저장 로직을 제거하고 완료 로그만 출력
    write("[LightECU] OTA 데이터 수신 완료!");
    write("[LightECU] 메모리 버퍼(gVumBuffer)에 %ld bytes가 저장되었습니다.", gCurrentReceived);
    write("[확인용] %s", gVumBuffer[0]);
    gIsUpdating = 0; 
  }
}
