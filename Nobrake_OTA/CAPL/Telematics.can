
/*@!Encoding:65001*/

variables
{
  // --- TCP/IP 통신 관련 ---
  dword gClientSocket = 0;
  char  gHttpRequest[512];
  byte  gRxBuffer[8192]; 
  long  gReceivedBytes = 0;
  word gServerVersion = 0;
  
  // --- 파일 및 데이터 버퍼 관련 ---
  dword gFileHandle = 0; 
  char  gFileName[64] = "OTA_Update_Data.bin";
  byte  gFileData[5242880]; // 최대 5MB 수신 데이터 저장용 배열
  long  gIsFileLoaded = 0;   // 파일 로드 상태 플래그 (로컬 테스트 용)

  // --- CAN FD OTA 전송 제어 관련 ---
  msTimer sendTimer;      // 시뮬레이션 중단 방지용 타이머
  long    gCurrentBlock = 0;
  long    gTotalBlocks = 0;
}

/*
// [1] 'h' 키: 클라우드 서버 접속 및 파일 다운로드 시작
on key 'h'
{
  if (gClientSocket == 0) 
  {
    gReceivedBytes = 0;
    
    // 파일 쓰기 모드 오픈
    gFileHandle = openFileWrite(gFileName, 1);
    
    if (gFileHandle != 0)
    {
      gClientSocket = tcpOpen(0, 0);
      tcpConnect(gClientSocket, ipGetAddressAsNumber("127.0.0.1"), 8080);
      write("[TM] 시스템: 클라우드 서버 연결 시도 중...");
    }
    else { write("[TM] 에러: 파일을 생성할 수 없습니다."); }
  }
}

// [2] TCP 연결 성공 시 HTTP GET 요청 송신 ( 상세 구현 필요 )
void OnTcpConnect(dword socket, long result)
{
  if (result == 0)
  {
    snprintf(gHttpRequest, elcount(gHttpRequest), 
             "GET /api/ota/download HTTP/1.1\r\n"
             "Host: 127.0.0.1:8080\r\n"
             "Connection: close\r\n\r\n");
    
    tcpSend(socket, gHttpRequest, strlen(gHttpRequest));
    tcpReceive(socket, gRxBuffer, elcount(gRxBuffer)); 
    write("[TM] 시스템: 서버 연결 성공 및 요청 전송.");
  }
}

// [3] TCP 데이터 수신: 파일 기록 및 전송용 버퍼에 저장
void OnTcpReceive(dword socket, long result, dword address, dword port, char buffer[], dword size)
{
  long i;
  char versionStr[10];
  long pos;
  
  if (result == 0 && size > 0)
  {
    
    // [추가] 처음 수신된 패킷에서 버전 헤더 찾기 (단순 문자열 검색)
    // 헤더 예시: "X-OTA-Version: 15"
    pos = strstr_off(buffer, 0, "X-OTA-Version: ");
    if (pos != -1)
    {
      // "X-OTA-Version: " 이후의 숫자를 읽어옴
      substr_cpy(versionStr, buffer, pos + 15, 2, elcount(versionStr));
      gServerVersion = (word)atol(versionStr);
      write("[TM] 서버 응답 확인: 배포 버전 %d", gServerVersion);
    }
    // 파일에 바이너리 기록
    fileWriteBinaryBlock(gRxBuffer, size, gFileHandle);
    
    // [수정] memcpy_obj 대신 직접 루프 복사 (빨간 밑줄 해결)
    if (gReceivedBytes + size <= elcount(gFileData))
    {
      for(i = 0; i < size; i++)
      {
        gFileData[gReceivedBytes + i] = gRxBuffer[i];
      }
    }

    gReceivedBytes += size;
    write("[TM] 다운로드 중... (%ld bytes 수신)", gReceivedBytes);
    tcpReceive(socket, gRxBuffer, elcount(gRxBuffer));
  }
}

// [4] TCP 연결 종료: 다운로드 완료 후 CAN 전송 시퀀스 진입
void OnTcpClose(dword socket, long result)
{
  if (gFileHandle != 0) { fileClose(gFileHandle); gFileHandle = 0; }
  
  write("[TM] 다운로드 완료: %ld bytes", gReceivedBytes);
  tcpClose(gClientSocket);
  gClientSocket = 0;

  // OTA 전송 파라미터 계산 (6바이트 단위 분할)
  gTotalBlocks = (gReceivedBytes + 5) / 6; 
  gCurrentBlock = 0;

}
*/

/*
아직 클라우드 연결 전이기 때문에 일단 주석
on key 'f'
{
    // 메타데이터(0x200) 우선 전송
  SendMetadata();
  
  // 데이터 전송 타이머 시작 (10ms 후 시작)
  setTimer(sendTimer, 10);
}
*/

//f키를 누르면 가상의 데이터를 생성하여 vum에게 전달함
//서버랑 연결하는 코드를 구현했지만 아직 클라우드 배포전이기 때문에 이렇게 구현
//만약 vum에서 업데이트 요청이 들어오고 업데이트 조건을 체크한 후 업데이트 요청 메세지를 송신하면 다음과 같이 수정
//on key 'f' -> on message VUM_OTA_EligiblilityAndReq
on key 'f'
{
  // 1. 만약 서버에서 받은 데이터가 없다면 로컬 파일을 직접 로드 시도
  if (gReceivedBytes == 0)
  {
    makeDummyDataForTest();
  }

  // 2. 데이터가 로드된 상태라면 전송 시작
  if (gReceivedBytes > 0)
  {
    gTotalBlocks = (gReceivedBytes + 5) / 6; 
    gCurrentBlock = 0;

    SendMetadata();
    setTimer(sendTimer, 10);
  }
  else
  {
    write("[TM] 에러: 서버 다운로드 데이터가 없고 로컬 파일 로드도 실패했습니다.");
  }
}

// 클라우드 연결 전 더미데이터 생성용
void makeDummyDataForTest()
{
  long i;
  long dummySize;
  
  // 1. 테스트하고 싶은 임의의 크기 설정 (예: 10KB)
  dummySize = 10 * 1024; 
  
  if (dummySize > elcount(gFileData)) 
    dummySize = elcount(gFileData);

  // 2. 루프를 돌며 가상의 데이터(0, 1, 2, 3...)를 버퍼에 채움
  for (i = 0; i < dummySize; i++)
  {
    gFileData[i] = (byte)(i % 256);
  }

  // 3. 전송에 필요한 변수들 강제 설정
  gReceivedBytes = dummySize;
  gServerVersion = 2; // 로컬 가상 테스트임을 알리는 버전 번호
  
  //체크용 로그
  write("[TM] 테스트: 가상 데이터 생성 완료 (%ld bytes)", gReceivedBytes);
  write("[TM] 알림: 파일 없이 내부 버퍼 데이터로 전송을 시작합니다.");
}

// [5] OTA 메타데이터 송신 함수 (ID: 0x200)
void SendMetadata()
{
  message TMU_OTA_Metadata msg;
  msg.can = 1;
  msg.FDF = 1; // CAN FD 활성화
  msg.Sig_TargetECU_ID = 0x01;
  msg.Sig_OTA_TotalSize = gReceivedBytes;
  msg.Sig_OTA_Version = gServerVersion;
  output(msg);
  //체크용 로그
  write("[TM] 차량 내 OTA 전송 시작: 메타데이터(0x200) 전송됨.");
}

// [6] OTA 데이터 블록 순차 전송 타이머 (ID: 0x201)
on timer sendTimer
{
  message TMU_OTA_DataBlock msg;
  long baseIdx;
  
  if (gCurrentBlock < gTotalBlocks)
  {
    msg.can = 1;
    msg.FDF = 1;
    msg.Sig_BlockSeq = gCurrentBlock % 256; // 0~255 순환
    
    // 유효 데이터 길이 결정 (마지막 블록 예외 처리)
    if (gCurrentBlock == gTotalBlocks - 1 && gReceivedBytes % 6 != 0) 
      msg.Sig_BlockLen = gReceivedBytes % 6;
    else 
      msg.Sig_BlockLen = 6;

    baseIdx = gCurrentBlock * 6;

    // [수정] "no array possible here" 해결을 위한 .byte() 직접 할당
    msg.Sig_BlockData0_5.byte(0) = gFileData[baseIdx + 0];
    msg.Sig_BlockData0_5.byte(1) = gFileData[baseIdx + 1];
    msg.Sig_BlockData0_5.byte(2) = gFileData[baseIdx + 2];
    msg.Sig_BlockData0_5.byte(3) = gFileData[baseIdx + 3];
    msg.Sig_BlockData0_5.byte(4) = gFileData[baseIdx + 4];
    msg.Sig_BlockData0_5.byte(5) = gFileData[baseIdx + 5];

    output(msg);
    gCurrentBlock++;
    
    // 다음 블록 전송 주기 (부하 분산)
    setTimer(sendTimer, 1); 
  }
  else
  {
    // [7] 모든 블록 전송 후 종료 프레임 송신
    SendTransferEnd();
  }
}

// [7] OTA 전송 종료 알림 함수 (ID: 0x202)
void SendTransferEnd()
{
  message TMU_OTA_TransferEnd msg;
  msg.can = 1;
  msg.FDF = 1;
  msg.Sig_TargetECU_ID = 0x01;
  msg.Sig_TransferEnd = 1;
  msg.Sig_TotalBlocks = gTotalBlocks;
  output(msg);
  //체크용 로그
  write("[TM] 차량 내 OTA 전송 완료: 종료 프레임(0x202) 전송됨.");
}