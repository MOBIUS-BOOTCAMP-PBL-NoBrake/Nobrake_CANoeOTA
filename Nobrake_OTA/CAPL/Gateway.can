/*@!Encoding:65001*/
includes
{
  
}

variables
{
  
}

on message *
{
  // 1. CAN 3(TM)에서 오는 메시지를 CAN 2(VUM)로 중계
  if (this.can == 3 && this.dir == Rx)
  {
    if (this.id == 0x200 || this.id == 0x201 || this.id == 0x202)
    {
      this.can = 2; // 목적지를 Update 망(CAN 2)으로 설정
      output(this);
      if (this.id == 0x200) write("[GW] OTA 시작 메타데이터 중계");
      if (this.id == 0x202) write("[GW] OTA 종료 알림 중계");
    }
  }
  
  // 2. CAN 2(VUM)에서 오는 요청(0x150)을 CAN 3(TM)으로 중계
  if (this.can == 2 && this.dir == Rx)
  {
    if (this.id == 0x150)
    {
      this.can = 3; // 목적지를 Telematics 망(CAN 3)으로 설정
      output(this);
      write("[GW] VUM -> TM 요청 중계 (0x150)");
    }
  }
}
